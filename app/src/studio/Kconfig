## app/src/studio/Kconfig
```kconfig
# Copyright (c) 2024 The ZMK Contributors
# SPDX-License-Identifier: MIT

menuconfig ZMK_STUDIO
    bool "Studio Support"
    select ZMK_STUDIO_RPC if !ZMK_SPLIT || ZMK_SPLIT_ROLE_CENTRAL
    select PM_DEVICE # Needed for physical layout switching
    help
      Add firmware support for realtime keymap updates (ZMK Studio)

if ZMK_STUDIO

module = ZMK_STUDIO
module-str = zmk_studio
source "subsys/logging/Kconfig.template.log_config"

menuconfig ZMK_STUDIO_LOCKING
    bool "Lock Support"

if ZMK_STUDIO_LOCKING

config ZMK_STUDIO_LOCK_IDLE_TIMEOUT_SEC
    int "Idle Timeout"
    default 600
    range 0 86400
    help
      Seconds until an unlocked Studio locks again without a received RPC.
      Each decoded RPC renews the idle timeout only while unlocked. Zero
      disables the idle timeout. This does not control BLE advertising.

config ZMK_STUDIO_LOCK_ON_DISCONNECT
    bool "Lock On Disconnect"
    default y

endif

config ZMK_STUDIO_LOCK_BLE_DIRECT_ADVERTISING_ON_UNLOCK
    bool "Start bounded BLE discovery with the physical Studio unlock key"
    depends on ZMK_STUDIO_TRANSPORT_BLE
    default y if ZMK_STUDIO_LOCKING && ZMK_BLE
    help
      The physical Studio unlock behavior also opens a separate discovery
      window for Web Bluetooth. Discovery stops on the selected host's Studio
      subscription or RPC, or at its own timeout. Lock state and RPC traffic do
      not restart or extend advertising. The historical option name is kept
      for compatibility; the current BLE backend uses undirected advertising.

config ZMK_STUDIO_BLE_ADVERTISING_TIMEOUT_SEC
    int "Studio BLE discovery timeout in seconds"
    depends on ZMK_STUDIO_LOCK_BLE_DIRECT_ADVERTISING_ON_UNLOCK
    range 1 3600
    default 90
    help
      Maximum duration of a physical discovery request. A new physical key
      press restarts this window. The Studio lock idle timeout is independent.

menuconfig ZMK_STUDIO_RPC
    bool "Remote Procedure Calls (RPC)"
    select NANOPB
    # These two save stack size
    imply NANOPB_NO_ERRMSG
    imply NANOPB_WITHOUT_64BIT
    imply NANOPB_NO_ENCODE_SIZE_CHECK
    imply ZMK_STUDIO_LOCKING if !ARCH_POSIX
    select CBPRINTF_LIBC_SUBSTS if ARCH_POSIX
    select SETTINGS
    select ZMK_BEHAVIOR_METADATA
    select ZMK_BEHAVIOR_LOCAL_IDS
    select RING_BUFFER
    select ZMK_KEYMAP_SETTINGS_STORAGE
    select ZMK_KEYMAP_LAYER_REORDERING
    help
      Add firmware support for studio RPC protocol

if ZMK_STUDIO_RPC

menu "Transports"

DT_CHOSEN_ZMK_STUDIO_RPC_UART := zmk,studio-rpc-uart

config ZMK_STUDIO_TRANSPORT_UART
    bool "Serial"
    select SERIAL
    select RING_BUFFER
    default y if $(dt_chosen_enabled,$(DT_CHOSEN_ZMK_STUDIO_RPC_UART))

if ZMK_STUDIO_TRANSPORT_UART

config ZMK_STUDIO_TRANSPORT_UART_RX_STACK_SIZE
    int "RX Stack Size"
    depends on !UART_INTERRUPT_DRIVEN
    default 512

config ZMK_STUDIO_TRANSPORT_UART_RX_PRIORITY
    int "RX Thread Priority"
    depends on !UART_INTERRUPT_DRIVEN
    default 9

endif

config ZMK_STUDIO_TRANSPORT_BLE
    bool "BLE (GATT)"
    select RING_BUFFER
    select BT_USER_DATA_LEN_UPDATE
    depends on ZMK_BLE
    default y


config BT_CONN_TX_MAX
    default 64 if ZMK_STUDIO_TRANSPORT_BLE

if ZMK_STUDIO_TRANSPORT_BLE

config ZMK_STUDIO_TRANSPORT_BLE_PREF_LATENCY
    int "BLE Transport preferred latency"
    default 10
    help
      When the studio UI is connected, a lower latency can be requested in order
      to make the interactions between keyboard and studio faster.

endif

endmenu

config ZMK_STUDIO_RPC_THREAD_STACK_SIZE
    int "RPC Thread Stack Size"
    default 4096

config ZMK_STUDIO_RPC_RX_BUF_SIZE
    int "RX Buffer Size"
    default 30

config ZMK_STUDIO_RPC_TX_BUF_SIZE
    int "TX Buffer Size"
    default 64

config ZMK_STUDIO_RPC_CUSTOM_SUBSYSTEM_PRINT_LIST_ON_START
    bool "Print Custom Subsystem List on Start"
    default n
    help
      Enable debug logging for custom subsystems on start.

config ZMK_STUDIO_RPC_CUSTOM_SUBSYSTEM_IDENTIFIER_MAX_LEN
    int "Custom Subsystem Identifier Max Length"
    default 32

config ZMK_STUDIO_RPC_CUSTOM_SUBSYSTEM_REQUEST_PAYLOAD_MAX_BYTES
    int "Custom Subsystem Request Payload Max Bytes"
    default ZMK_STUDIO_RPC_RX_BUF_SIZE
    help
      Maximum size of the payload in a custom subsystem request.
      Defaults to ZMK_STUDIO_RPC_RX_BUF_SIZE so the generated custom subsystem request
      payload capacity follows the configured RPC RX buffer size unless explicitly
      overridden.

endif

endif
```
